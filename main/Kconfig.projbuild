## main/Kconfig.projbuild
```kconfig
menu "SWD RAM stress test"

    config SWD_DEMO_RAM_ADDRESS
        hex "Target RAM test address"
        default 0x20000000
        help
            Start address of a writable target RAM region. The demo backs up
            and restores this region, but the target must not use it while the
            stress test is running.

    config SWD_DEMO_BLOCK_SIZE
        int "Transfer block size (bytes)"
        range 4 65536
        default 8192
        help
            Number of bytes transferred by each measured read or write.

    config SWD_DEMO_ITERATIONS
        int "Stress-test iterations"
        range 1 1000000
        default 100
        help
            Number of write, read, and byte-for-byte verification cycles.

    config SWD_DEMO_PROGRESS_INTERVAL
        int "Progress report interval"
        range 1 1000000
        default 10
        help
            Print cumulative performance and stability statistics after this
            many iterations.

endmenu

menu "Rev 8 power profiler test"

    config SWD_DEMO_PROF_RUN_SECONDS
        int "Auto-ranging test duration (seconds)"
        range 1 3600
        default 5

    config SWD_DEMO_PROF_DBG_EN_PIN
        int "DBG_EN GPIO"
        range 0 61
        default 57

    config SWD_DEMO_PROF_SDA_PIN
        int "INA226 I2C SDA GPIO"
        range 0 61
        default 17

    config SWD_DEMO_PROF_SCL_PIN
        int "INA226 I2C SCL GPIO"
        range 0 61
        default 18

    config SWD_DEMO_PROF_ALERT_PIN
        int "INA226 shared /ALERT GPIO"
        range 0 61
        default 4

    config SWD_DEMO_PROF_RANGE_D_PIN
        int "Range latch D GPIO"
        range 0 61
        default 19

    config SWD_DEMO_PROF_RANGE_CLK_PIN
        int "Range latch clock GPIO"
        range 0 61
        default 37

    config SWD_DEMO_PROF_HIGH_RB_PIN
        int "HIGH latch readback GPIO"
        range 0 61
        default 38

    config SWD_DEMO_PROF_MID_RB_PIN
        int "MID latch readback GPIO"
        range 0 61
        default 5

endmenu
```

## sdkconfig.defaults.spi
```kconfig
# ESP32-S31 Rev 7.1 SPI SWD comparison configuration.
CONFIG_IDF_TARGET="esp32s31"
CONFIG_ESPTOOLPY_FLASHMODE_QIO=y
CONFIG_ESPTOOLPY_FLASHSIZE_16MB=y
CONFIG_COMPILER_OPTIMIZATION_SIZE=y
CONFIG_SPIRAM=y
CONFIG_SPIRAM_MODE_OCT=y
CONFIG_SPIRAM_XIP_FROM_PSRAM=y
CONFIG_SPIRAM_SPEED_250M=y
CONFIG_SPIRAM_TRY_ALLOCATE_WIFI_LWIP=y
CONFIG_SPIRAM_ALLOW_BSS_SEG_EXTERNAL_MEMORY=y
CONFIG_SPIRAM_ALLOW_NOINIT_SEG_EXTERNAL_MEMORY=y
CONFIG_ESP_DEFAULT_CPU_FREQ_MHZ_320=y
CONFIG_ESP_MAIN_TASK_STACK_SIZE=8192
CONFIG_ESP_SWD_PHY_AXC2T245=y
CONFIG_ESP_SWD_CLK_PIN=10
CONFIG_ESP_SWD_DATA_OUT_PIN=16
CONFIG_ESP_SWD_DATA_IN_PIN=15
CONFIG_ESP_SWD_DATA_NOE_PIN=12
CONFIG_ESP_SWD_DATA_DIR1_PIN=14
CONFIG_ESP_SWD_DATA_DIR2_PIN=13
CONFIG_ESP_SWD_CLK_NOE_PIN=8
CONFIG_ESP_SWD_NRST_PIN=11
CONFIG_ESP_SWD_BOOT_PIN=9
CONFIG_ESP_SWD_DEFAULT_CLOCK_HZ=500000
CONFIG_ESP_SWD_FAST_DELAY_NOPS=0
CONFIG_ESP_SWD_TURNAROUND_DELAY_US=1
CONFIG_ESP_SWD_DEDICATED_TRANSLATOR_CONTROLS=y
CONFIG_ESP_SWD_USE_SPI=y
CONFIG_ESP_SWD_PERF_INSTRUMENTATION=y
```
